## Kconfig
```kconfig
config ZMK_BEHAVIOR_TIME
    bool "Enable time digit/commit/clear behavior"
    default y
    select RTC
```

## dts/bindings/behaviors/zmk,behavior-time-clear.yaml
```yaml
description: Behavior zum Löschen des Eingabebuffers
compatible: "zmk,behavior-time-clear"

include: zero_param.yaml
```

## dts/bindings/behaviors/zmk,behavior-time-commit.yaml
```yaml
description: Behavior zum Übernehmen der eingegebenen Uhrzeit
compatible: "zmk,behavior-time-commit"

include: zero_param.yaml
```
